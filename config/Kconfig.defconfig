## config/Kconfig.defconfig
```kconfig
config LV_DISP_DEF_REFR_PERIOD
    int "Default display refresh period"
    default 30
```

## config/boards/shields/lily58_dongle/Kconfig.defconfig
```kconfig
if SHIELD_LILY58_DONGLE

config ZMK_KEYBOARD_NAME
    default "Lily58 Dongle"

config ZMK_SPLIT
    default y

config ZMK_SPLIT_ROLE_CENTRAL
    default y

config ZMK_SPLIT_BLE_CENTRAL_PERIPHERALS
    default 2

config BT_MAX_CONN
    default 7

config BT_MAX_PAIRED
    default 7

# Enable Display and SPI drivers required by the Prospector module
config ZMK_DISPLAY
    default y

config SPI
    default y

config LV_Z_BITS_PER_PIXEL
    default 16

endif
```
