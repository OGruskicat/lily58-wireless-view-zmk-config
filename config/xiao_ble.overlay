&spi1 {
    status = "okay";
    compatible = "nordic,nrf-spim";
    
    st7789: st7789@0 {
        compatible = "sitronix,st7789v";
        reg = <0>;
        spi-max-frequency = <80000000>;
    };
};
